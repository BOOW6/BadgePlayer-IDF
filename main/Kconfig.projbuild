## main/Kconfig.projbuild
```kconfig
menu "Badge Player"

config BADGE_CLOUD_ENDPOINT
    string "Cloud endpoint"
    default "https://aibaji.app.workbuddy.host"
    help
        云端根地址。设备激活、后续拉歌单都打这个域名。

config BADGE_CLOUD_KEY
    string "Cloud app key"
    default "wbpk_HICdTD2EmCudhhwCc5Evnn_ASEVc0iHhE3eg55Pb1t7HJ2bb3vQvwJE"
    help
        应用访问 key（x-wb-webapp-access-key 请求头）。
        这不是密钥，是应用标识，泄露不致命；真正的凭证是每台机自己的 secret。

endmenu
```

## sdkconfig.defaults
```kconfig
# 本机板卡实测：ESP32-S3 (QFN56) rev0.2 + 16MB Flash + 8MB PSRAM
CONFIG_IDF_TARGET="esp32s3"
CONFIG_ESPTOOLPY_FLASHSIZE_16MB=y

# PSRAM（N16R8，Octal 80MHz）
CONFIG_SPIRAM=y
CONFIG_SPIRAM_MODE_OCT=y
CONFIG_SPIRAM_SPEED_80M=y

# 分区表：固件约 1.7MB，默认 single-app 的 factory 仅 1MB 放不下，
# 改用自定义 partitions.csv（factory 4MB + storage 12MB）
CONFIG_PARTITION_TABLE_CUSTOM=y
CONFIG_PARTITION_TABLE_CUSTOM_FILENAME="partitions.csv"

# ---------------- 蓝牙 ----------------
# 只做外设（Peripheral），用 NimBLE 省内存。配网期间手机是 Central。
CONFIG_BT_ENABLED=y
CONFIG_BT_NIMBLE_ENABLED=y
CONFIG_BT_NIMBLE_MAX_CONNECTIONS=1
CONFIG_BT_NIMBLE_ATT_PREFERRED_MTU=517
CONFIG_BT_NIMBLE_HOST_TASK_STACK_SIZE=5120
# 不做扫描、不做主机，关掉省内存
# CONFIG_BT_NIMBLE_ROLE_CENTRAL is not set
# CONFIG_BT_NIMBLE_ROLE_OBSERVER is not set
# 不保存配对信息，配网是一次性动作，没必要占 NVS
# CONFIG_BT_NIMBLE_NVS_PERSIST is not set

# WiFi 与 BLE 共用一套射频，必须开共存
CONFIG_SW_COEXIST_ENABLE=y

# ---------------- 网络与存储 ----------------
# main 启动时要挂 SPIFFS + 起 BLE + 建队列，默认 3584 不够
CONFIG_ESP_MAIN_TASK_STACK_SIZE=8192

# https 下载音频必须带根证书
CONFIG_MBEDTLS_CERTIFICATE_BUNDLE=y
CONFIG_MBEDTLS_CERTIFICATE_BUNDLE_DEFAULT_FULL=y

# SPIFFS 缓存音频
CONFIG_SPIFFS_MAX_PARTITIONS=3

# 控制台日志级别
CONFIG_LOG_DEFAULT_LEVEL_INFO=y

# ---------------- 业务配置（见 main/Kconfig.projbuild） ----------------
CONFIG_BADGE_CLOUD_ENDPOINT="https://aibaji.app.workbuddy.host"
CONFIG_BADGE_CLOUD_KEY="wbpk_HICdTD2EmCudhhwCc5Evnn_ASEVc0iHhE3eg55Pb1t7HJ2bb3vQvwJE"
```
